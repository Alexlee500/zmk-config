## config/west.yml
```yaml
manifest:
  defaults:
    revision: v0.3
  remotes:
    - name: zmkfirmware
      url-base: https://github.com/zmkfirmware
    - name: alexlee500
      url-base: https://github.com/alexlee500
  projects:
    - name: zmk
      remote: zmkfirmware
      import: app/west.yml
    - name: zmk-component-raytac-dongle
      remote: alexlee500
  self:
    path: config
```
